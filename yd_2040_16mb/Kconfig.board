## yd_2040_16mb/Kconfig.board
```kconfig
# Copyright (c) 2021 Yonatan Schachter
# SPDX-License-Identifier: Apache-2.0

config BOARD_YD_2040_16MB
	bool "Raspberry Pi Pico YD-2040 16Mbyte Edition"
	depends on SOC_RP2040
```

## yd_2040_16mb/Kconfig.defconfig
```kconfig
# Copyright (c) 2021 Yonatan Schachter
# SPDX-License-Identifier: Apache-2.0

if BOARD_YD_2040_16MB

config BOARD
	default "yd_2040_16mb"

config RP2_FLASH_W25Q080
	default y

if I2C_DW

config I2C_DW_CLOCK_SPEED
	default 100

endif #I2C_DW

endif # BOARD_RPI_PICO
```
